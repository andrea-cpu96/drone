## virtual_pid/virtual_pid/build/Kconfig/arch/Kconfig
```kconfig
# Load Zephyr Arch Kconfig descriptions.
osource "/home/andrea/zephyrproject/zephyr/arch/rx/Kconfig"
osource "/home/andrea/zephyrproject/zephyr/arch/x86/Kconfig"
osource "/home/andrea/zephyrproject/zephyr/arch/xtensa/Kconfig"
osource "/home/andrea/zephyrproject/zephyr/arch/sparc/Kconfig"
osource "/home/andrea/zephyrproject/zephyr/arch/riscv/Kconfig"
osource "/home/andrea/zephyrproject/zephyr/arch/posix/Kconfig"
osource "/home/andrea/zephyrproject/zephyr/arch/openrisc/Kconfig"
osource "/home/andrea/zephyrproject/zephyr/arch/mips/Kconfig"
osource "/home/andrea/zephyrproject/zephyr/arch/arm64/Kconfig"
osource "/home/andrea/zephyrproject/zephyr/arch/arm/Kconfig"
osource "/home/andrea/zephyrproject/zephyr/arch/arc/Kconfig"
```

## virtual_pid/virtual_pid/build/Kconfig/boards/Kconfig
```kconfig
# Load Zephyr board Kconfig descriptions.
osource "/home/andrea/zephyrproject/zephyr/boards/qemu/cortex_m3/Kconfig"
```

## virtual_pid/virtual_pid/build/Kconfig/boards/Kconfig.defconfig
```kconfig
# Load Zephyr board defconfig descriptions.
osource "/home/andrea/zephyrproject/zephyr/boards/qemu/cortex_m3/Kconfig.defconfig"
```

## virtual_pid/virtual_pid/build/Kconfig/boards/Kconfig.qemu_cortex_m3
```kconfig
# Load board Kconfig descriptions.
osource "/home/andrea/zephyrproject/zephyr/boards/qemu/cortex_m3/Kconfig.qemu_cortex_m3"
```

## virtual_pid/virtual_pid/build/Kconfig/boards/Kconfig.sysbuild
```kconfig
# Load Sysbuild board Kconfig descriptions.
osource "/home/andrea/zephyrproject/zephyr/boards/qemu/cortex_m3/Kconfig.sysbuild"
```
